## boards/e73C08/Kconfig.e73C08
```kconfig
# Copyright (c) 2026 Pete Johanson
# SPDX-License-Identifier: MIT

config BOARD_E73C08
    select SOC_NRF52840_QIAA
    select ZMK_BOARD_COMPAT if BOARD_E73C08_NRF52840_ZMK
    imply RETAINED_MEM if BOARD_E73C08_NRF52840_ZMK
    imply RETENTION if BOARD_E73C08_NRF52840_ZMK
    imply RETENTION_BOOT_MODE if BOARD_E73C08_NRF52840_ZMK
```

## boards/e73C08/board.yml
```yaml
board:
  name: e73C08
  full_name: KBlade nRF52840
  vendor: kblade
  socs:
    - name: nrf52840
      variants:
        - name: zmk
```

## boards/shields/prospector_ms/Kconfig.defconfig
```kconfig
# Prospector Scanner defaults



config ZMK_KEYBOARD_NAME
    default "pro-rece2"

config ZMK_DISPLAY
    default n

config PROSPECTOR_SCANNER_TASK_WATCHDOG
    bool "Software watchdog that reboots the scanner if the display or core thread stops"
    default n
    select TASK_WDT
    help
      Arms a pure-software task watchdog (no hardware WDT, so firmware
            updates via the UF2 bootloader are unaffected). If the system
            workqueue liveness work stops running for 30s, the device records the
            hang and reboots instead of sitting frozen. The record is reported in
            the boot log ("Recovered from crash").

# MIPI DBI for ST7789V (bool required for Zephyr 3.5.0 compatibility)
config MIPI_DBI
    bool
    default y

config SPI
    default y

# ST7789V pixel format
choice ST7789V_PIXEL_FORMAT
    default ST7789V_RGB565
endchoice
```
