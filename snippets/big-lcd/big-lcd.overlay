/*
 * big-lcd snippet：240x320 的 ST7789V，横屏用满 320 像素宽。
 *
 * 小屏是 240x280（旋转后 280x240），需要 x-offset=20 把 280 的画面居中，
 * 所以不要用小屏去跑这个 snippet。
 *
 * snippet 的 overlay 在 shield overlay 之后应用，所以这里覆盖的
 * width / x-offset 会生效；其余参数（height / mdac / gamma ...）保持
 * prospector_e73.overlay 里的值不动。
 */
&st7789v {
    width = <320>;
    x-offset = <0>;
};
